## main/Kconfig.projbuild
```kconfig
#
# I use the following resource to learn how to create KConfig
# configurations:
# https://medium.com/@bhautik.markeye/esp-idf-configuration-how-to-add-custom-configuration-in-project-config-728f81b8d0d8.
#

menu "OpenThread Deep Sleep Sender"

  config TX_POWER
    int 'Set the 802.15.4 TX power used by OpenThread'
    range -128 127
    default 20
    help
        Set the 802.15.4 transmission power (in dBm) for OpenThread.
        The recommended TX power values are 20 dBm, 9 dBm, 0 dBm, and -25 dBm.

    config POLL_PERIOD
      int 'Set the poll period of the Sleepy End Device'
      range 0 67108863
      default 3000
      help
          The poll period (in ms) determines how often the Sleepy End Device will
          ask to its parent router for updates on any packets it has received.

    config COAP_SERVER_PORT
      int 'The port number for the CoAP server.'
      default 5683
      help
          Sets the port used by CoAP server side.

    config SERVER_IP_ADDRESS
      string 'The IP address of the server to send CoAP packets to.'
      help
          Sets the IPv6 address of the server to send CoAP packets to.

    config SCENARIO
      int 'The specific role that the device will play during the experiment.'
      default 1
      range 1 3
      help
          Enter "1" if the device simulates the motion sensor at the front door.
          Enter "2" if the device simulates the air quality monitor in the bedroom.
          Enter "3" if the device simulates the motion sensor at the second story back door.
endmenu
```
